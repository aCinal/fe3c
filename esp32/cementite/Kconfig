## esp32/cementite/Kconfig
```kconfig
menu "cementite (fe3c)"

    config FE3C_SUPPORT_CURVE_ED25519
        bool "Enable support for the Ed25519 curve"
        default y
        help
            Enable support for the Ed25519 curve.

    config FE3C_SUPPORT_CURVE_ED448
        bool "Enable support for the Ed448 curve"
        default n
        help
            Enable support for the Ed448 curve.

    config FE3C_OPTIMIZATION_SKIP_ZEROIZATION
        bool "Skip secret zeroization"
        default n
        help
            Disable zeroization of intermediate results on stack, which may marginally increase
            performance and reduce code footprint, but decreases security in systems where stack
            is shared with unsafe code, which may read data left behind by crypto operations.

    config FE3C_OPTIMIZATION_COMB_METHOD
        bool "Use comb method for scalar multiplication"
        default y
        help
            Enable comb method of scalar multiplication, which will increase data footprint,
            but will hugely increase performance.

    config FE3C_OPTIMIZATION_FAST_SQUARING
        bool "Use optimized squaring in the field"
        default y
        help
            Use a dedicated routine for squaring in the field instead of reusing the multiplication
            code.

endmenu  # cementite (fe3c)
```

## esp32/components/cementite/Kconfig
```kconfig
menu "cementite (fe3c)"

    config FE3C_SUPPORT_CURVE_ED25519
        bool "Enable support for the Ed25519 curve"
        default y
        help
            Enable support for the Ed25519 curve.

    config FE3C_ED25519_COMB_METHOD
        bool "Use comb method for Ed25519 scalar multiplication"
        depends on FE3C_SUPPORT_CURVE_ED25519
        default y
        help
            Enable comb method of scalar multiplication for Ed25519, which will increase data footprint,
            but will hugely increase performance.

    config FE3C_ED25519_SMALL_PRECOMPUTATION
        bool "Use smaller comb method precomputation tables for Ed25519"
        depends on FE3C_ED25519_COMB_METHOD
        default y
        help
            Minimize the size of Ed25519 precomputation tables when using the comb method.
            On ESP32 this seems to have no downside as it both reduces the memory
            footprint and increases performance.

    config FE3C_ED25519_LATTICE_BASIS_REDUCTION
        bool "Use lattice basis reduction for Ed25519 verification"
        depends on FE3C_SUPPORT_CURVE_ED25519
        default n
        help
            Enable lattice basis reduction (eprint:2020/454) during Ed25519 verification, which will increase
            code footprint, but may increase verification performance.

    config FE3C_USE_SHA512_HARDWARE
        bool "Use SHA512 hardware acceleration when possible"
        depends on FE3C_SUPPORT_CURVE_ED25519 && IDF_TARGET_ARCH_XTENSA
        default n
        help
            Use SHA512 hardware acceleration when possible. This will significantly
            reduce stack usage and increase performance for large messages, but may
            cause blocking for some SoC variants.

    config FE3C_SUPPORT_CURVE_ED448
        bool "Enable support for the Ed448 curve"
        default n
        help
            Enable support for the Ed448 curve.

    config FE3C_ED448_COMB_METHOD
        bool "Use comb method for Ed448 scalar multiplication"
        depends on FE3C_SUPPORT_CURVE_ED448
        default y
        help
            Enable comb method of scalar multiplication for Ed448, which will increase data footprint,
            but will hugely increase performance.

    config FE3C_ED448_SMALL_PRECOMPUTATION
        bool "Use smaller comb method precomputation tables for Ed448"
        depends on FE3C_ED448_COMB_METHOD
        default n
        help
            Minimize the size of Ed448 precomputation tables when using the comb method,
            which decreases the memory footprint, but marginally decreases performance
            as well.

    config FE3C_ED448_LATTICE_BASIS_REDUCTION
        bool "Use lattice basis reduction for Ed448 verification"
        depends on FE3C_SUPPORT_CURVE_ED448
        default n
        help
            Enable lattice basis reduction (eprint:2020/454) during Ed448 verification, which will increase
            code footprint, but may increase verification performance.

    config FE3C_PARALLEL_GROUP_OPS
        bool "Use parallel group arithmetic when possible"
        depends on IDF_TARGET_ARCH_XTENSA && (FE3C_SUPPORT_CURVE_ED25519 || FE3C_SUPPORT_CURVE_ED448)
        default n
        help
            When possible, use parallel implementations of the group arithmetic which yield
            great performance benefits in systems with small CPU load.

    config FE3C_SKIP_ZEROIZATION
        bool "Skip secret zeroization"
        depends on FE3C_SUPPORT_CURVE_ED25519 || FE3C_SUPPORT_CURVE_ED448
        default n
        help
            Disable zeroization of intermediate results on stack, which may marginally increase
            performance and reduce code footprint, but decreases security in systems where stack
            is shared with unsafe code, which may read data left behind by crypto operations.

    config FE3C_ENABLE_SANITY_CHECKS
        bool "Enable sanity checks"
        default n
        help
            Enable development assertions and sanity checks.

endmenu  # cementite (fe3c)
```

## examples/esp32/main/Kconfig.projbuild
```kconfig
menu "fe3c example application"

    choice EXAMPLE_WIFI_MODE
        prompt "Wi-Fi mode"
        default EXAMPLE_WIFI_MODE_SOFTAP
        help
            Run the example application as an access point (SoftAP) or as a station
            connected to an existing network.
        config EXAMPLE_WIFI_MODE_SOFTAP
            bool "SoftAP"
        config EXAMPLE_WIFI_MODE_STA
            bool "Station"
    endchoice

    config EXAMPLE_WIFI_SSID
        string "Wi-Fi SSID"
        default "Fe3CExample"
        help
            SSID (network name) of the:
            - SoftAP run on the ESP32, if the SoftAP mode has been selected,
            - access point the ESP32 will connect to, if the Station mode has been selected.

    config EXAMPLE_WIFI_PASS
        string "Wi-Fi Password"
        default "password"
        help
            Wi-Fi password (WPA or WPA2) to the:
            - SoftAP run on the ESP32, if the SoftAP mode has been selected,
            - access point the ESP32 will connect to, if the Station mode has been selected.

    config EXAMPLE_WIFI_MAX_CONNECT_RETRIES
        int "Number of connection retries before giving up"
        depends on EXAMPLE_WIFI_MODE_STA
        default 3
        help
            Set the maximum number of retries to the access point before giving up.

endmenu  # fe3c example application
```
